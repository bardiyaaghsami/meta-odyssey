## meta-odyssey/conf/layer.conf
```bitbake
# Public ODYSSEY STM32MP135D board layer.
# Recipes are bbappends only. ST layers are not modified.

BBPATH .= ":${LAYERDIR}"

BBFILES += "${LAYERDIR}/recipes-*/*/*.bb \
            ${LAYERDIR}/recipes-*/*/*.bbappend \
"

BBFILE_COLLECTIONS += "odyssey"
BBFILE_PATTERN_odyssey := "^${LAYERDIR}/"
BBFILE_PRIORITY_odyssey = "8"

LAYERDEPENDS_odyssey = "core openembedded-layer stm-st-stm32mp st-openstlinux"
LAYERSERIES_COMPAT_odyssey = "scarthgap"
LAYERVERSION_odyssey = "1"
```
